## package/corkscrew/Config.in
```kconfig
config BR2_PACKAGE_CORKSCREW
	bool "corkscrew"
	#depends on BR2_INSTALL_LIBSTDCPP
	#select BR2_PACKAGE_FONTCONFIG
	#select BR2_PACKAGE_XLIB_LIBX11 if BR2_PACKAGE_XORG7
	#select BR2_PACKAGE_XLIB_LIBXEXT if BR2_PACKAGE_XORG7
	help
	   Corkscrew is a tool for tunneling SSH through HTTP proxies.

	   http://www.agroman.net/corkscrew/
```

## package/espeak/Config.in
```kconfig
config BR2_PACKAGE_ESPEAK
	bool "espeak"
	depends on BR2_PACKAGE_PORTAUDIO
	help
	  Text-To-Speech utility.

	  http://espeak.sourceforge.net
```

## package/ifmetric/Config.in
```kconfig
config BR2_PACKAGE_IFMETRIC
	bool "ifmetric"
	depends on BR2_INET_IPV6
	depends on BR2_TOOLCHAIN_HAS_THREADS
```

## package/motionlights/Config.in
```kconfig
config BR2_PACKAGE_MOTIONLIGHTS
	bool "motionlights"
	depends on (BR2_UCLIBC_VERSION_SNAPSHOT || BR2_TOOLCHAIN_USES_GLIBC) # spawn.h
	depends on BR2_INSTALL_LIBSTDCPP
	depends on BR2_LARGEFILE
	depends on BR2_USE_WCHAR
	depends on BR2_TOOLCHAIN_HAS_THREADS
	depends on BR2_PACKAGE_OPENCV
```

## package/quint/Config.in
```kconfig
config BR2_PACKAGE_QUINT
	bool "quint"
	help
          Shader-testing environment for Qt5
```

## package/sphinxbase/Config.in
```kconfig
config BR2_PACKAGE_SPHINXBASE
	bool "sphinxbase"
	help
	  Sphinx Voice Recognition Software.

	  http://cmusphinx.sourceforge.net
```

## package/view20/Config.in
```kconfig
config BR2_PACKAGE_VIEW20
	bool "view20"
	depends on BR2_PACKAGE_LIBV4L
	depends on BR2_PACKAGE_FFMPEG
	help
          tec20 application for starting a QML file with
          accelerated video playback
```
